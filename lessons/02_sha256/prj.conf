## CMakeLists.txt
```
cmake_minimum_required(VERSION 3.20.0)

find_package(Zephyr REQUIRED HINTS $ENV{ZEPHYR_BASE})
project(wings_crypto_phase2)

target_sources(app PRIVATE src/main.c)
```

## prj.conf
```kconfig
# Serial output via the DK debugger's UART-to-USB bridge.
CONFIG_SERIAL=y
CONFIG_CONSOLE=y
CONFIG_UART_CONSOLE=y
CONFIG_PRINTK=y

# Nordic PSA Crypto integration and secure random generation.
CONFIG_NRF_SECURITY=y
CONFIG_MBEDTLS_PSA_CRYPTO_C=y
CONFIG_PSA_WANT_GENERATE_RANDOM=y

# Working-memory and tick settings from NCS 2.4.0's crypto/rng sample.
CONFIG_MAIN_STACK_SIZE=4096
CONFIG_HEAP_MEM_POOL_SIZE=4096
CONFIG_MBEDTLS_ENABLE_HEAP=y
CONFIG_MBEDTLS_HEAP_SIZE=8192
CONFIG_SYS_CLOCK_TICKS_PER_SEC=1000

# Request SHA-256 support explicitly.
CONFIG_PSA_WANT_ALG_SHA_256=y
```

## src/main.c
```c
#include <stdint.h>
#include <string.h>
#include <psa/crypto.h>
#include <zephyr/kernel.h>
#include <zephyr/sys/printk.h>

static psa_status_t print_sha256(const char *message)
{
	uint8_t hash[PSA_HASH_LENGTH(PSA_ALG_SHA_256)];
	size_t hash_length = 0;
	psa_status_t status;

	printk("\nMessage: %s\n", message);
	/* Exclude C's terminating zero byte from the message. */
	status = psa_hash_compute(PSA_ALG_SHA_256,
				  (const uint8_t *)message, strlen(message),
				  hash, sizeof(hash), &hash_length);
	printk("psa_hash_compute: %d\n", (int)status);
	if (status != PSA_SUCCESS) {
		printk("FAIL: SHA-256\n");
		return status;
	}

	printk("SHA-256 (%u bytes): ", (unsigned int)hash_length);
	for (size_t i = 0; i < hash_length; ++i) {
		printk("%02x", (unsigned int)hash[i]);
	}
	printk("\n");
	return PSA_SUCCESS;
}

int main(void)
{
	psa_status_t status;

	printk("\nWings crypto - Phase 2: SHA-256\n");
	status = psa_crypto_init();
	printk("psa_crypto_init: %d\n", (int)status);
	if (status != PSA_SUCCESS) {
		printk("FAIL: PSA initialization\n");
		return 0;
	}

	if (print_sha256("EMG") != PSA_SUCCESS) {
		return 0;
	}
	/* The baseline changes just one character: p -> P. */
	if (print_sha256("EMG test Packet") != PSA_SUCCESS) {
		return 0;
	}
	printk("\nPhase 2 complete\n");
	return 0;
}
```
