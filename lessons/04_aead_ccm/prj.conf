## CMakeLists.txt
```
cmake_minimum_required(VERSION 3.20.0)
find_package(Zephyr REQUIRED HINTS $ENV{ZEPHYR_BASE})
project(wings_crypto_phase4)
target_sources(app PRIVATE src/main.c src/demo_crypto.c)
```

## prj.conf
```kconfig
# Console and PSA settings, as in the earlier lessons.
CONFIG_SERIAL=y
CONFIG_CONSOLE=y
CONFIG_UART_CONSOLE=y
CONFIG_PRINTK=y
CONFIG_NRF_SECURITY=y
CONFIG_MBEDTLS_PSA_CRYPTO_C=y
CONFIG_PSA_WANT_GENERATE_RANDOM=y
CONFIG_MAIN_STACK_SIZE=4096
CONFIG_HEAP_MEM_POOL_SIZE=4096
CONFIG_MBEDTLS_ENABLE_HEAP=y
CONFIG_MBEDTLS_HEAP_SIZE=8192
CONFIG_SYS_CLOCK_TICKS_PER_SEC=1000

# Verified in NCS 2.4.0: AES-CCM and the CryptoCell PSA driver.
CONFIG_PSA_WANT_ALG_CCM=y
CONFIG_PSA_CRYPTO_DRIVER_CC3XX=y
```

## src/main.c
```c
#include <string.h>
#include <zephyr/kernel.h>
#include <zephyr/sys/byteorder.h>
#include <zephyr/sys/printk.h>
#include <zephyr/sys/util.h>
#include "demo_crypto.h"

static void print_hex(const char *label, const uint8_t *bytes, size_t length)
{
	printk("%s (%u bytes): ", label, (unsigned int)length);
	for (size_t i = 0; i < length; ++i) {
		printk("%02x", (unsigned int)bytes[i]);
	}
	printk("\n");
}

int main(void)
{
	static const uint16_t samples[] = {
		2010, 2034, 1995, 2051, 2070, 2028, 2001, 2040
	};
	/* Tiny teaching header: version=1, type=1 (EMG_RAW),
	 * sequence=1 (32-bit little endian), sample_count=8.
	 * AAD is visible but authenticated. This is not the final Wings format.
	 */
	const uint8_t aad[] = {1, 1, 1, 0, 0, 0, ARRAY_SIZE(samples)};
	uint8_t plaintext[2 * ARRAY_SIZE(samples)];
	uint8_t nonce[DEMO_NONCE_SIZE];
	uint8_t encrypted[sizeof(plaintext) + DEMO_TAG_SIZE];
	uint8_t recovered[sizeof(plaintext)];
	size_t encrypted_length = 0;
	size_t recovered_length = 0;
	psa_key_id_t key = 0;
	psa_status_t status;
	psa_status_t destroy_status;

	printk("\nWings crypto - Phase 4: AES-128-CCM\n");
	printk("TEST KEY - NOT FOR PRODUCTION\n");
	status = psa_crypto_init();
	printk("psa_crypto_init: %d\n", (int)status);
	if (status != PSA_SUCCESS) {
		return 0;
	}
	status = demo_import_test_key(&key);
	printk("psa_import_key: %d\n", (int)status);
	if (status != PSA_SUCCESS) {
		return 0;
	}

	/* Explicit byte encoding, not the memory layout of a C struct. */
	for (size_t i = 0; i < ARRAY_SIZE(samples); ++i) {
		sys_put_le16(samples[i], &plaintext[2 * i]);
	}
	printk("Header: version=1 type=EMG_RAW sequence=1 count=%u\n",
		(unsigned int)ARRAY_SIZE(samples));
	print_hex("AAD", aad, sizeof(aad));
	print_hex("Plaintext samples", plaintext, sizeof(plaintext));

	status = demo_encrypt(key, nonce, aad, sizeof(aad),
		plaintext, sizeof(plaintext),
		encrypted, sizeof(encrypted), &encrypted_length);
	printk("AEAD encrypt (including nonce generation): %d\n", (int)status);
	if (status != PSA_SUCCESS) {
		goto cleanup;
	}
	if (encrypted_length != sizeof(plaintext) + DEMO_TAG_SIZE) {
		status = PSA_ERROR_GENERIC_ERROR;
		printk("FAIL: unexpected encrypted length\n");
		goto cleanup;
	}
	print_hex("Nonce", nonce, sizeof(nonce));
	print_hex("Ciphertext", encrypted, sizeof(plaintext));
	print_hex("Authentication tag", encrypted + sizeof(plaintext), DEMO_TAG_SIZE);

	/* PSA authenticates using the key, nonce, AAD, ciphertext and tag.
	 * It does NOT receive our original plaintext to do that check.
	 */
	status = demo_decrypt(key, nonce, aad, sizeof(aad),
		encrypted, encrypted_length,
		recovered, sizeof(recovered), &recovered_length);
	printk("psa_aead_decrypt: %d\n", (int)status);
	if (status != PSA_SUCCESS) {
		printk("REJECTED: do not use the recovered buffer\n");
		goto cleanup;
	}
	printk("Authentication: PASS\n");
	/* Additional local test only, after authentication has succeeded. */
	if (recovered_length != sizeof(plaintext) ||
	    memcmp(plaintext, recovered, sizeof(plaintext)) != 0) {
		status = PSA_ERROR_GENERIC_ERROR;
		printk("FAIL: round-trip mismatch\n");
		goto cleanup;
	}
	print_hex("Recovered bytes", recovered, recovered_length);
	printk("Recovered samples:");
	for (size_t i = 0; i < ARRAY_SIZE(samples); ++i) {
		printk(" %u", (unsigned int)sys_get_le16(&recovered[2 * i]));
	}
	printk("\nExact match: YES\n");

cleanup:
	destroy_status = psa_destroy_key(key);
	printk("psa_destroy_key: %d\n", (int)destroy_status);
	printk("%s\n", status == PSA_SUCCESS && destroy_status == PSA_SUCCESS ?
		"Phase 4 complete" : "Phase 4 FAILED");
	return 0;
}
```

## src/demo_crypto.c
```c
#include <string.h>
#include "demo_crypto.h"

psa_status_t demo_import_test_key(psa_key_id_t *key)
{
	/* TEST KEY - NOT FOR PRODUCTION. Public key bytes, not a real secret. */
	static const uint8_t test_key[16] = {
		0x00, 0x01, 0x02, 0x03, 0x04, 0x05, 0x06, 0x07,
		0x08, 0x09, 0x0a, 0x0b, 0x0c, 0x0d, 0x0e, 0x0f
	};
	psa_key_attributes_t attributes = PSA_KEY_ATTRIBUTES_INIT;
	psa_set_key_type(&attributes, PSA_KEY_TYPE_AES);
	psa_set_key_bits(&attributes, 128);
	psa_set_key_algorithm(&attributes, PSA_ALG_CCM);
	psa_set_key_usage_flags(&attributes,
		PSA_KEY_USAGE_ENCRYPT | PSA_KEY_USAGE_DECRYPT);
	psa_set_key_lifetime(&attributes, PSA_KEY_LIFETIME_VOLATILE);
	psa_status_t status = psa_import_key(&attributes, test_key, sizeof(test_key), key);
	psa_reset_key_attributes(&attributes);
	return status;
}

psa_status_t demo_encrypt(psa_key_id_t key, uint8_t nonce[DEMO_NONCE_SIZE],
	const uint8_t *aad, size_t aad_length,
	const uint8_t *plaintext, size_t plaintext_length,
	uint8_t *output, size_t output_size, size_t *output_length)
{
	*output_length = 0;
	psa_status_t status = psa_generate_random(nonce, DEMO_NONCE_SIZE);
	if (status != PSA_SUCCESS) {
		return status;
	}
	return psa_aead_encrypt(key, PSA_ALG_CCM, nonce, DEMO_NONCE_SIZE,
		aad, aad_length, plaintext, plaintext_length,
		output, output_size, output_length);
}

psa_status_t demo_decrypt(psa_key_id_t key, const uint8_t nonce[DEMO_NONCE_SIZE],
	const uint8_t *aad, size_t aad_length,
	const uint8_t *input, size_t input_length,
	uint8_t *output, size_t output_size, size_t *output_length)
{
	*output_length = 0;
	psa_status_t status = psa_aead_decrypt(key, PSA_ALG_CCM,
		nonce, DEMO_NONCE_SIZE, aad, aad_length,
		input, input_length, output, output_size, output_length);
	if (status != PSA_SUCCESS) {
		memset(output, 0, output_size);
		*output_length = 0;
	}
	return status;
}
```

## src/demo_crypto.h
```c
#ifndef WINGS_LESSON4_DEMO_CRYPTO_H
#define WINGS_LESSON4_DEMO_CRYPTO_H

#include <psa/crypto.h>

#define DEMO_NONCE_SIZE 13
#define DEMO_TAG_SIZE 16 /* PSA_ALG_CCM's default tag size. */

/* Call psa_crypto_init() first; caller destroys the returned volatile key. */
psa_status_t demo_import_test_key(psa_key_id_t *key);

/* Generates a fresh random nonce; output is ciphertext followed by tag.
 * Random nonces are for this small experiment, not a production nonce policy.
 */
psa_status_t demo_encrypt(psa_key_id_t key, uint8_t nonce[DEMO_NONCE_SIZE],
	const uint8_t *aad, size_t aad_length,
	const uint8_t *plaintext, size_t plaintext_length,
	uint8_t *output, size_t output_size, size_t *output_length);

/* Only consume output on PSA_SUCCESS. On failure output is cleared and its
 * reported length is zero. Arguments must point to valid caller buffers.
 */
psa_status_t demo_decrypt(psa_key_id_t key, const uint8_t nonce[DEMO_NONCE_SIZE],
	const uint8_t *aad, size_t aad_length,
	const uint8_t *input, size_t input_length,
	uint8_t *output, size_t output_size, size_t *output_length);

#endif
```
