## CMakeLists.txt
```
cmake_minimum_required(VERSION 3.20.0)

find_package(Zephyr REQUIRED HINTS $ENV{ZEPHYR_BASE})
project(wings_crypto_phase1)

target_sources(app PRIVATE src/main.c)
```

## prj.conf
```kconfig
# Serial output via the DK debugger's UART-to-USB bridge.
CONFIG_SERIAL=y
CONFIG_CONSOLE=y
CONFIG_UART_CONSOLE=y
CONFIG_PRINTK=y

# Nordic PSA Crypto integration and secure random generation.
CONFIG_NRF_SECURITY=y
CONFIG_MBEDTLS_PSA_CRYPTO_C=y
CONFIG_PSA_WANT_GENERATE_RANDOM=y

# Working-memory and tick settings from NCS 2.4.0's crypto/rng sample.
CONFIG_MAIN_STACK_SIZE=4096
CONFIG_HEAP_MEM_POOL_SIZE=4096
CONFIG_MBEDTLS_ENABLE_HEAP=y
CONFIG_MBEDTLS_HEAP_SIZE=8192
CONFIG_SYS_CLOCK_TICKS_PER_SEC=1000
```

## src/main.c
```c
#include <stdint.h>
#include <psa/crypto.h>
#include <zephyr/kernel.h>
#include <zephyr/sys/printk.h>

#define RANDOM_BYTE_COUNT 16

int main(void)
{
	uint8_t random_bytes[RANDOM_BYTE_COUNT];
	psa_status_t status;

	printk("\nWings crypto - Phase 1\n");
	status = psa_crypto_init();
	printk("psa_crypto_init: %d\n", (int)status);
	if (status != PSA_SUCCESS) {
		printk("FAIL: PSA initialization\n");
		return 0;
	}

	status = psa_generate_random(random_bytes, sizeof(random_bytes));
	printk("psa_generate_random: %d\n", (int)status);
	if (status != PSA_SUCCESS) {
		printk("FAIL: random generation\n");
		return 0;
	}

	printk("Random bytes (%u): ", (unsigned int)sizeof(random_bytes));
	for (size_t i = 0; i < sizeof(random_bytes); ++i) {
		printk("%02x", (unsigned int)random_bytes[i]);
	}
	printk("\nPhase 1 complete\n");
	return 0;
}
```
